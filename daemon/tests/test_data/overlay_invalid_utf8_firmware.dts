/dts-v1/;
/plugin/;

/ {
    compatible = "xlnx,zynqmp";

    fragment@0 {
        target-path = "/";
        __overlay__ {
            fpga_region {
                compatible = "fpga-region";
                fpga-mgr = <&fpga_full>;
                #address-cells = <2>;
                #size-cells = <2>;
                // This will contain invalid UTF-8 bytes: 0xFF 0xFE
                firmware-name = [FF FE 74 65 73 74 00];
            };
        };
    };
};

